## ESP32firmwareServer/main/Kconfig.projbuild
```kconfig
menu "Project Configuration"

config WIFI_SSID
    string "WiFi SSID"
    default "myssid"
    help
	SSID (network name) for the example to connect to.

config WIFI_PASSWORD
    string "WiFi Password"
    default "mypassword"
    help
	WiFi password (WPA or WPA2) for the example to use.

config IP_SERVER
	string "IP Server"
	default "ipServer"
	help
	Ip to connect to server 
	
config PORT_SERVER
 	string "Port servive on Server"
	default "portServer"
	help
	Port to connect to server 
	
config SCAN_CHANNEL
 	string "Channel for ScanMode"
	default "1"
	help
	Channel for ScanMode
	
endmenu
```
